## software/sdkconfig.defaults
```kconfig
#
# ESP32 options
#
# Serial console:
#       Component config > ESP System Settings > Channel for console output > choose USB Serial/JTAG Controller
CONFIG_IDF_INIT_VERSION="$IDF_INIT_VERSION"

#
# Target Device
#
CONFIG_IDF_TARGET="esp32c3"
CONFIG_IDF_TARGET_ESP32C3=y


# UART Specifications, enable UART R/W options
#CONFIG_ESP_CONSOLE_UART_DEFAULT=y
CONFIG_ESP_CONSOLE_USB_SERIAL_JTAG=y


# Generic options
CONFIG_COMPILER_OPTIMIZATION_PERF=y
CONFIG_ESPTOOLPY_FLASHSIZE_4MB=y
#CONFIG_ESP32_XTAL_FREQ_AUTO=y
#CONFIG_XTAL_FREQ_AUTO=y


# Bluetooh related
#CONFIG_BT_ENABLED=y
#CONFIG_BT_CONTROLLER_ONLY=y
# Enable Dualmode (BLE and BR/EDR)
#CONFIG_BTDM_CTRL_MODE_BTDM=y
##CONFIG_BTDM_CTRL_MODE_BR_EDR_ONLY=y
#CONFIG_ESP_COREDUMP_ENABLE_TO_FLASH=y


#
# FreeRTOS
# Enable FreeRTOS stats formatting functions, needed for 'tasks' console command
#CONFIG_FREERTOS_USE_TRACE_FACILITY=y
#CONFIG_FREERTOS_USE_STATS_FORMATTING_FUNCTIONS=y

#
# Add here other options
#
```
